/dts-v1/;
/plugin/;


/* fragment 1 ── create the fan device */
&{/} {
        pwm_fan_cpu: pwm-fan-cpu {
                compatible      = "pwm-fan";
                /* ctrl  ch  period(ns) polarity(1=inverted) */
                pwms           = <&pwm3 0 40000 0>;
                cooling-levels = <0 64 128 192 255>;
                #cooling-cells = <2>;
        };
};
